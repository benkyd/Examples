int MAXPINCLK = 10; // Define Digital Port 10
int MAXPINCS = 9; // Define Digital Port 9
int MAXPINDIN = 8; // Define Digital Port 8
 
unsigned char x; //occupies bytes on the memory 
unsigned char y; //occupies bytes on the memory
 
unsigned char disp1[38][8]={
{0x3C,0x42,0x42,0x42,0x42,0x42,0x42,0x3C}, //Char 0 
{0x10,0x18,0x14,0x10,0x10,0x10,0x10,0x10}, //Char 1 
{0x7E,0x2,0x2,0x7E,0x40,0x40,0x40,0x7E}, //Char 2 
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{0x0,0x7F,0x2,0x4,0x8,0x10,0x20,0x7F}, //Char Z
};
 
void MX7219_WRITE_byte(unsigned char DATA)  {   
            unsigned char x;
     digitalWrite(MAXPINCS,LOW); 
     for(x=8;x>=1;x--)
          {   
             digitalWrite(MAXPINCLK,LOW);
             digitalWrite(MAXPINDIN,DATA&0x80);// Extracting a bit data
             DATA = DATA<<1;
             digitalWrite(MAXPINCLK,HIGH);
           }                                 
}
 
void MX7219_WRITE(unsigned char address,unsigned char dat) {
        digitalWrite(MAXPINCS,LOW);
        MX7219_WRITE_byte(address);           // The address code of the LED
        MX7219_WRITE_byte(dat);               //The data figure on LED 
        digitalWrite(MAXPINCS,HIGH);
}
 
void InitMAX7219(void) {
 MX7219_WRITE(0x09, 0x00);       //Set decoding BCD
 MX7219_WRITE(0x0a, 0x03);       //Set the brightness 
 MX7219_WRITE(0x0b, 0x07);       //Set scan & limit 8 LEDs
 MX7219_WRITE(0x0c, 0x01);       //On power-down mode is 0，normal mode is 1
 MX7219_WRITE(0x0f, 0x00);       //To test display 1 EOT，display 0
}
 
void setup() {
  
  pinMode(MAXPINCLK,OUTPUT);
  pinMode(MAXPINCS,OUTPUT);
  pinMode(MAXPINDIN,OUTPUT);
  delay(50);
  InitMAX7219();
}
 
void loop() { 
   for(y=0;y<38;y++) {
   for(x=1;x<9;x++)
    MX7219_WRITE(x,disp1[y][x-1]);
    delay(500);
  } 
}
